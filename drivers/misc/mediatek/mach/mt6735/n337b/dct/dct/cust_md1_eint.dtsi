/*
 * Generated by MTK SP DrvGen Version 03.13.6 for MT6735M. Copyright MediaTek Inc. (C) 2013.
 * Tue Sep 27 09:54:59 2016
 * Do Not Modify the File.
 */

/*********************************************
 *MD EINT DTSI File
*********************************************/

&eintc {
	MD1_SIM1_HOT_PLUG_EINT@1 {
		compatible = "mediatek, MD1_SIM1_HOT_PLUG_EINT-eint";
		interrupts = <1 4>;
		debounce = <1 100000>;
		dedicated = <1 0>;
		src_pin = <1 1>;
		sockettype=<1 0>;
	};

	MD1_SIM2_HOT_PLUG_EINT@2 {
		compatible = "mediatek, MD1_SIM2_HOT_PLUG_EINT-eint";
		interrupts = <2 4>;
		debounce = <2 100000>;
		dedicated = <2 0>;
		src_pin = <2 2>;
		sockettype=<2 0>;
	};

};
