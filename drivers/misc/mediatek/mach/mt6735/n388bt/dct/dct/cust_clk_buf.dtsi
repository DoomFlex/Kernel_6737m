/*
 * Generated by MTK SP DrvGen Version 03.13.6 for MT6735. Copyright MediaTek Inc. (C) 2013.
 * Fri Oct 21 17:30:06 2016
 * Do Not Modify the File.
 */

&rf_clock_buffer_ctrl {
	compatible = "mediatek, rf_clock_buffer";
	buffer1 = <2>;
	buffer2 = <2>;
	buffer3 = <2>;
	buffer4 = <2>;
};
